## aidoll_v2/sdkconfig.defaults
```kconfig
# ESP-IDF configuration for aidoll_v2

# WiFi
CONFIG_ESP_WIFI_STATIC_RX_BUFFER_NUM=10
CONFIG_ESP_WIFI_DYNAMIC_RX_BUFFER_NUM=32
CONFIG_ESP_WIFI_DYNAMIC_TX_BUFFER_NUM=32

# PSRAM
CONFIG_SPIRAM=y
CONFIG_SPIRAM_MODE_OCT=y
CONFIG_SPIRAM_SPEED_80M=y

# Increase main task stack size for Rust
CONFIG_ESP_MAIN_TASK_STACK_SIZE=32768

# Use default partition table (single factory app, no OTA)

# HTTP/WebSocket client
CONFIG_ESP_TLS_INSECURE=y
CONFIG_ESP_TLS_SKIP_SERVER_CERT_VERIFY=y

# Increase HTTP buffer sizes
CONFIG_HTTPD_MAX_REQ_HDR_LEN=1024
CONFIG_HTTPD_MAX_URI_LEN=1024

# Logging
CONFIG_LOG_DEFAULT_LEVEL_INFO=y
```
